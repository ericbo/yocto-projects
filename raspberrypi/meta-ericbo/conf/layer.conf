## raspberrypi/meta-ericbo/conf/layer.conf
```bitbake
# We have a conf and classes directory, add to BBPATH
BBPATH .= ":${LAYERDIR}"

# We have recipes-* directories, add to BBFILES
BBFILES += "${LAYERDIR}/recipes-*/*/*.bb \
            ${LAYERDIR}/recipes-*/*/*.bbappend"

BBFILE_COLLECTIONS += "meta-ericbo"
BBFILE_PATTERN_meta-ericbo = "^${LAYERDIR}/"
BBFILE_PRIORITY_meta-ericbo = "20"

LAYERSERIES_COMPAT_meta-ericbo = "dunfell"
```
